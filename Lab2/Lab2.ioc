# file: Lab2.ioc
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Mcu.Family=STM32F4
Mcu.Name=STM32F407V(E-G)Tx
Mcu.Package=LQFP100
NVIC.PriorityGroup=NVIC_PRIORITYGROUP_4
ProjectManager.HeapSize=0x200
ProjectManager.StackSize=0x400
ProjectManager.TargetToolchain=STM32CubeIDE
RCC.AHBFreq_Value=16000000
RCC.APB1Freq_Value=16000000
RCC.APB2Freq_Value=16000000
RCC.CortexFreq_Value=16000000
RCC.HSE_VALUE=25000000
RCC.HSI_VALUE=16000000
RCC.LSE_VALUE=32768
RCC.SYSCLKFreq_VALUE=16000000
RCC.VCOOutputFreq_Value=192000000
board=custom

// file: Core/Src/main.c
/* USER CODE BEGIN Header */
/**
  ******************************************************************************
  * @file           : main.c
  * @brief          : Main program body
  ******************************************************************************
  * @attention
  *
  * Copyright (c) 2024 STMicroelectronics.
  * All rights reserved.
  *
  * This software is licensed under terms that can be found in the LICENSE file
  * in the root directory of this software component.
  * If no LICENSE file comes with this software, it is provided AS-IS.
  *
  ******************************************************************************
  */
/* USER CODE END Header */
#include "main.h"

void SystemClock_Config(void);
/* USER CODE BEGIN PFP */
void InitializePins(void);
/* USER CODE END PFP */

/* USER CODE BEGIN 0 */
void InitializePins(void){
	RCC->AHB1ENR |= RCC_AHB1ENR_GPIODEN;
	RCC->AHB1ENR |= RCC_AHB1ENR_GPIOAEN;
	// Mygtukas
	GPIOA->MODER &= ~0x3;
	GPIOA->PUPDR &= ~0x3;
	GPIOA->PUPDR |= 0x2;
	// Led'ai
	GPIOD->MODER |= 0x55 << 24;
	GPIOD->OTYPER &= ~(0xF << 12);
	GPIOD->OSPEEDR |= 0x55 << 24;
  }
/* USER CODE END 0 */

int main(void)
{
  /* USER CODE BEGIN 1 */
	int uzdNr = 3;
	int toggleOrange = 0;
	int freq = 500;
	InitializePins();
  /* USER CODE END 1 */

  /* MCU Configuration--------------------------------------------------------*/

  /* Reset of all peripherals, Initializes the Flash interface and the Systick. */
  HAL_Init();

  /* Configure the system clock */
  SystemClock_Config();

  /* Initialize all configured peripherals */

  /* Infinite loop */
  while (1)
  {

    /* USER CODE BEGIN 3 */
	//	  GPIOD->ODR |= GPIO_PIN_12;            - SET TO HIGH
	//	  GPIOD->ODR &= ~GPIO_PIN_12;           - CLEAR TO LOW
	//	  GPIOD->ODR ^= GPIO_PIN_12;            - TOGGLE
	// Zalia_Pin|Oranzine_Pin|Raudona_Pin|Melyna_Pin
	  if(uzdNr == 1){
		  // Sakykime kad Zalias led yra 1 bit'as (DEC 2), o melynas - 0 bit'as (DEC 1);
		  GPIOD->ODR |= (1 << 12) | (1 << 15);
		  HAL_Delay(1000);
		  GPIOD->ODR &= ~(1 << 15);
		  HAL_Delay(1000);
		  GPIOD->ODR &= ~(1 << 12);
		  GPIOD->ODR |= (1 << 15);
		  HAL_Delay(1000);
	  } else if(uzdNr == 2){
		  GPIOD->ODR ^= (1 << 15);
		  HAL_Delay(1000);

		  if (toggleOrange) {
			  GPIOD->ODR ^= (1 << 13);
		  }
		  toggleOrange = !toggleOrange;
	  } else if(uzdNr == 3){
		  if((GPIOA->IDR & GPIO_PIN_0) != 0){
			  GPIOD->ODR |= (1 << 13);
		  } /* else{
			  GPIOD->ODR &= ~Oranzine_Pin;
		  } */
	  }else if(uzdNr == 4){
  		  if((GPIOA->IDR & GPIO_PIN_0) != 0){
  			  freq += 1000;
  			HAL_Delay(150);
  		  }
  		  GPIOD->ODR &= ~(1 << 15);
  		  HAL_Delay(freq);
  		  GPIOD->ODR |= (1 << 15);
		  HAL_Delay(freq);
  	  }

  /* USER CODE END 3 */
}
}

void SystemClock_Config(void)
{
  RCC_OscInitTypeDef RCC_OscInitStruct = {0};
  RCC_ClkInitTypeDef RCC_ClkInitStruct = {0};

  /** Configure the main internal regulator output voltage
  */
  __HAL_RCC_PWR_CLK_ENABLE();
  __HAL_PWR_VOLTAGESCALING_CONFIG(PWR_REGULATOR_VOLTAGE_SCALE1);

  /** Initializes the RCC Oscillators according to the specified parameters
  * in the RCC_OscInitTypeDef structure.
  */
  RCC_OscInitStruct.OscillatorType = RCC_OSCILLATORTYPE_HSI;
  RCC_OscInitStruct.HSIState = RCC_HSI_ON;
  RCC_OscInitStruct.HSICalibrationValue = RCC_HSICALIBRATION_DEFAULT;
  RCC_OscInitStruct.PLL.PLLState = RCC_PLL_NONE;
  if (HAL_RCC_OscConfig(&RCC_OscInitStruct) != HAL_OK)
  {
    Error_Handler();
  }

  /** Initializes the CPU, AHB and APB buses clocks
  */
  RCC_ClkInitStruct.ClockType = RCC_CLOCKTYPE_HCLK|RCC_CLOCKTYPE_SYSCLK
                              |RCC_CLOCKTYPE_PCLK1|RCC_CLOCKTYPE_PCLK2;
  RCC_ClkInitStruct.SYSCLKSource = RCC_SYSCLKSOURCE_HSI;
  RCC_ClkInitStruct.AHBCLKDivider = RCC_SYSCLK_DIV1;
  RCC_ClkInitStruct.APB1CLKDivider = RCC_HCLK_DIV1;
  RCC_ClkInitStruct.APB2CLKDivider = RCC_HCLK_DIV1;

  if (HAL_RCC_ClockConfig(&RCC_ClkInitStruct, FLASH_LATENCY_0) != HAL_OK)
  {
    Error_Handler();
  }
}

void Error_Handler(void)
{
  __disable_irq();
  while (1)
  {
  }
}
